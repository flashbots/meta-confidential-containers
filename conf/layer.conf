## conf/layer.conf
```bitbake
# We have a conf and classes directory, add to BBPATH
BBPATH .= ":${LAYERDIR}"

# We have recipes-* directories, add to BBFILES
BBFILES += "${LAYERDIR}/recipes-*/*/*.bb \
            ${LAYERDIR}/recipes-*/*/*.bbappend"

BBFILE_COLLECTIONS += "meta-confidential-containers"
BBFILE_PATTERN_meta-confidential-containers = "^${LAYERDIR}/"
BBFILE_PRIORITY_meta-confidential-containers = "20"
LAYERVERSION_meta-confidential-containers = "4"
LAYERDEPENDS_meta-confidential-containers = "virtualization-layer"
LAYERSERIES_COMPAT_meta-confidential-containers = "scarthgap"

DISTRO_FEATURES_VIRTUALIZATION = " virtualization"
DISTRO_FEATURES_PODMAN = "seccomp kvm aufs sysvinit"

DISTRO_FEATURES:append = "${DISTRO_FEATURES_VIRTUALIZATION} \
                          ${DISTRO_FEATURES_PODMAN} \
                        "
```
